// Famyy: a family agent's body. Claude thinks (the brain on the laptop), Fo acts in the world, Famyy listens, shows and talks.
// Tools menu: Arduino Runs On = Core 0 (speech recognition owns core 1; on the same core the screen halves its frame rate)
//   config.h   pins, constants, shared enums
//   shared.h   the mailbox between the speech task and loop()
//   speech.*   wake phrase ("hey Famyy") and offline voice commands (ESP-SR)
//   voice.*    recording requests for the brain, playing its replies
//   net.*      Wi-Fi link to the brain (see PROTOCOL.md)
//   femi.*     what the brain has asked Femi to show
//   timer.*    countdown and pomodoro
//   face.*     the display: moods, cards, photos
//   creature.* Famyy itself: a little house with a face
//   fo.*       Fo, Wajo's errand agent, visiting the stage while it does a job
//   clips.*    short spoken cues in Famyy's voice (generated by brain/cmd/clips)
//   settings.* values kept across power-offs
//   touch.*    the capacitive touch pad
//   app.h      full-screen apps: runner.cpp (game), morse.cpp (morse teacher)
#include "config.h"
#include "shared.h"
#include "speech.h"
#include "timer.h"
#include "face.h"
#include "settings.h"
#include "touch.h"
#include "app.h"
#include "femi.h"
#include "voice.h"
#include "net.h"
#include "fo.h"
#include "clips.h"

volatile Face wanted = IDLE;
volatile bool listening = false;
volatile bool hackerMode = false;
volatile uint32_t moodUntil = 0;
volatile int timerReq = REQ_NONE;
volatile Ask asking = ASK_NONE;
volatile int appReq = APP_NONE;
volatile bool approvalOpen = false;
volatile int voiceAnswer = -1;

void setup() {
  Serial.begin(115200);
  settingsBegin();   // first, so the face starts with the saved theme
  touchBegin();      // measures the untouched pad: keep fingers off while it starts
  femiBegin();
  faceBegin();
  playerBegin();
  netBegin();
  speechBegin();
  randomSeed(esp_random());
}

// Fo's visit, with a sound for each moment, each played once per visit
static void foCues(const FoPose &p, uint32_t calledAt) {
  static uint32_t visit = 0;
  static uint8_t done = 0;
  if (p.phase == PH_NONE) return;
  if (calledAt != visit) {
    visit = calledAt;
    done = 0;
  }
  auto once = [&](uint8_t bit) {
    if (done & bit) return false;
    done |= bit;
    return true;
  };
  if (p.phase == PH_ENTER && once(1)) {
    playerSfx(SFX_WHOOSH);
    playerClipOf(CLIP_FO_START, CLIP_FO_START_N);   // "Let me ask Fo!"
  }
  if (p.phase == PH_SHAKE && p.tp >= 200 && once(2)) playerSfx(SFX_CLINK);
  static int reassured = -1;   // a few words every 14 s while Fo works: "Fo's still on it." "Almost there." ...
  if (p.phase == PH_WORK && p.tp >= 10000) {
    int step = (p.tp - 10000) / 14000;
    if (step != reassured) {
      reassured = step;
      playerClipOf(CLIP_FO_WAIT, CLIP_FO_WAIT_N);
    }
  } else if (p.phase != PH_WORK) {
    reassured = -1;
  }
  if (p.phase == PH_HANDOFF && once(16)) playerSfx(SFX_DING);
  if (p.phase == PH_HANDOFF && p.tp >= 600 && once(4)) playerSfx(SFX_SPARKLE);   // the result is caught
  if (p.phase == PH_SHRUG && once(32)) playerChime(false);
  if (p.phase == PH_LEAVE && p.tp >= 250 && once(64)) playerSfx(SFX_WHOOSH);
}

static void clearFlag(bool FemiView::*flag) {
  femiLock();
  femiView().*flag = false;
  femiUnlock();
}

void loop() {
  uint32_t now = millis();
  TouchInput touch = touchPoll(now);   // read every loop, so an old tap can't leak into something new
  FemiView v;
  femiLock();
  if (femiView().foState == FO_WORKING && (femiView().speaking || !femiView().busy)) {
    femiView().foState = FO_DONE;   // Famyy is answering (or the turn ended): Fo's job is over
    femiView().foSince = now;
  }
  v = femiView();
  femiUnlock();

  // Fo on the stage, and its sounds
  faceSetFo((FoState)v.foState, v.foCalledAt, v.foSince, (FoTask)v.foTask);
  FoPose fo = foPose(now, (FoState)v.foState, v.foCalledAt, v.foSince, 160);   // only its timing matters here
  foCues(fo, v.foCalledAt);

  // hello, the first time the brain is reachable
  static bool greeted = false;
  if (v.linkUp && !greeted) {
    greeted = true;
    playerSfx(SFX_JINGLE);
    playerClip(CLIP_HELLO);
    wanted = HAPPY;
    moodUntil = now + 2500;
  }

  // soft music while Claude thinks or Fo works (not while listening for a yes or no)
  playerMusic(v.busy && !v.speaking && !voiceRecording() && !v.approve);

  // soft ticks while Claude thinks, so a quiet moment never feels stuck
  static uint32_t nextTick = 0;
  if (!(v.busy && !v.speaking && !voiceRecording() && fo.phase == PH_NONE)) nextTick = now + 1500;
  else if (THINK_TICKS && now >= nextTick && playerQuiet()) {
    playerSfx(SFX_TICK);
    nextTick = now + 1600;
  }

  // take the pending timer request, if any, and let the timer advance
  int req = timerReq;
  if (req != REQ_NONE) timerReq = REQ_NONE;
  timerUpdate(now, req);
  settingsUpdate();
  if (timerPhase() == T_DONE && touch.tapped) timerReq = REQ_DISMISS;   // a tap silences a finished timer

  // ---------- what the brain asked for comes first ----------

  // a photo, until tapped or 20 s
  static uint32_t photoOnScreen = 0;   // arrival time of the photo being shown
  if (v.photo) {
    if (touch.tapped || now - v.photoSince > 20000) {
      clearFlag(&FemiView::photo);
      photoOnScreen = 0;
      faceRepaint();
      touch.tapped = false;
    } else {
      facePhotoFrame(now, femiPhoto(), v.photoCaption, photoOnScreen != v.photoSince);
      photoOnScreen = v.photoSince;
      delay(20);
      return;
    }
  } else if (photoOnScreen) {
    photoOnScreen = 0;
    faceRepaint();
  }

  // a list (recent calls, ...), until tapped or 45 s
  static uint32_t listOnScreen = 0;   // arrival time of the list being shown
  if (v.list) {
    if (touch.tapped || now - v.listSince > 45000) {
      clearFlag(&FemiView::list);
      listOnScreen = 0;
      faceRepaint();
      touch.tapped = false;
    } else {
      faceListFrame(now, v.listTitle, v.listItems, listOnScreen != v.listSince);
      listOnScreen = v.listSince;
      delay(20);
      return;
    }
  } else if (listOnScreen) {
    listOnScreen = 0;
    faceRepaint();
  }

  // a reminder, until tapped
  if (v.remind) {
    if (touch.tapped) {
      char j[64];
      snprintf(j, sizeof j, "{\"type\":\"ack\",\"id\":\"%s\"}", v.remindId);
      netSend(F_EVENT, j);
      clearFlag(&FemiView::remind);
      touch.tapped = false;
    } else {
      faceCardFrame(now, true, "Reminder", v.remindText, "tap when done", 0);
      delay(10);
      return;
    }
  }

  // an approval: say "yes" or tap = yes; say "no" or hold 2 s = no; 60 s untouched = no answer
  if (v.approve) {
    if (!approvalOpen) {   // listen for a spoken yes or no while the card is up
      voiceAnswer = -1;
      approvalOpen = true;
      speechRearm();
    }
    int answer = voiceAnswer;
    for (int i = 0; i < touch.releases; i++) {
      if (touch.releasedMs[i] < EXIT_SHOW_MS) answer = 1;
    }
    float hold = touch.down && touch.heldMs > 300 ? (touch.heldMs - 300) / float(EXIT_HOLD_MS - 300) : 0;
    if (hold >= 1) answer = 0;
    if (answer >= 0 || now - v.approveSince > 60000) {
      if (answer >= 0) {
        char j[80];
        snprintf(j, sizeof j, "{\"type\":\"approval\",\"id\":\"%s\",\"ok\":%s}", v.approveId, answer ? "true" : "false");
        netSend(F_EVENT, j);
        if (answer) playerClipOf(CLIP_YES, CLIP_YES_N);   // "On it!"
        else playerClip(CLIP_NO);                          // "Okay, I won't."
      }
      approvalOpen = false;
      voiceAnswer = -1;
      speechPause();   // the request carries on: no wake phrase until it's done
      clearFlag(&FemiView::approve);
      touch.tapped = false;
    } else {
      faceCardFrame(now, false, "OK to do this?", v.approveText, "say yes/tap  hold=no", hold);
      delay(10);
      return;
    }
  }

  // ---------- apps (game, morse teacher) ----------
  static const App *app = nullptr;
  int a = appReq;
  if (a != APP_NONE) appReq = APP_NONE;
  if (a == APP_RUNNER) app = &RUNNER_APP;
  if (a == APP_MORSE)  app = &MORSE_APP;
  if (a > APP_NONE) app->start(now);
  if (a == APP_QUIT || timerPhase() == T_DONE || v.speaking) app = nullptr;   // a finished timer or Femi talking ends any app
  if (app && !app->update(now, touch)) app = nullptr;

  // holding the pad for 2 s leaves any app; the bar appears after the first 0.8 s
  float exitHold = 0;
  if (app && touch.down && touch.heldMs > EXIT_SHOW_MS) {
    exitHold = (touch.heldMs - EXIT_SHOW_MS) / float(EXIT_HOLD_MS - EXIT_SHOW_MS);
    if (exitHold >= 1) app = nullptr;
  }

  // ---------- conversation ----------
  bool busy = v.busy || voiceRecording() || playerBusy();
  static bool wasBusy = false;
  static uint32_t busySince = 0;
  if (busy && !wasBusy) busySince = now;
  // the brain went quiet for 2 minutes in the middle of a request: give up on it
  if (v.busy && !v.speaking && !voiceRecording() && now - max(busySince, v.faceSince) > 120000) {
    clearFlag(&FemiView::busy);
    busy = false;
  }
  if (wasBusy && !busy) speechRearm();   // done answering: listen for "hey Famyy" again
  wasBusy = busy;

  // a tap while Famyy listens, thinks or talks stops it
  if (!app && touch.tapped && busy && timerPhase() != T_DONE) {
    if (voiceRecording()) {
      voiceCancel();
    } else {
      playerStop();
      netSend(F_EVENT, "{\"type\":\"stop\"}");   // the brain drops the turn in progress
    }
    femiLock();
    femiView().busy = false;
    if (femiView().foState == FO_WORKING) {   // Fo was out on the job: it shrugs and goes
      femiView().foState = FO_FAILED;
      femiView().foSince = now;
    }
    femiUnlock();
    busy = false;
    wasBusy = false;
    speechRearm();
    touch.tapped = false;   // this tap was "stop", not "talk"
  }

  // tap to talk, when nothing else is going on
  if (!app && touch.tapped && !busy && v.linkUp && timerPhase() != T_DONE) {
    speechPause();
    if (!voiceStart("tap")) speechRearm();
  }

  // doze off after a long quiet spell; "hey Famyy" wakes it as usual
  static uint32_t lastActive = 0;
  if (app || busy || listening || timerPhase() != T_OFF || wanted != IDLE) lastActive = now;
  else if (now - lastActive > DOZE_MIN * 60000UL) wanted = SLEEPING;

  if (app) {
    faceAppFrame(now, *app, exitHold);
    delay(5);
    return;
  }

  // ---------- the face ----------
  Face f = wanted;
  if ((f == HAPPY || f == THINKING) && now > moodUntil) {   // timed moods fall back to listening or idle
    wanted = listening ? LISTENING : IDLE;
    f = wanted;
  }
  if (timerPhase() == T_DONE) {
    f = ALARM;   // a finished timer beats everything
  } else if (voiceRecording()) {
    f = LISTENING;
  } else if (v.speaking) {
    f = TALKING;
  } else if (v.busy) {
    f = v.face == BF_WORKING ? WORKING : THINKING;
  } else if (f == IDLE && timerPhase() == T_FOCUS && !timerPaused()) {
    f = FOCUS;
  }
  // words for the bubbles: what was heard, how it's going, and what Famyy is saying
  Words words = {v.heard, v.heardSince, v.busy ? v.line : "", v.caption, v.speakSince, v.speakMs};
  faceFrame(now, f, words);
  delay(10);   // give the speech tasks room to breathe
}
